/ {
    mipi_dbi: mipi_dbi {
        compatible = "zephyr,mipi-dbi-spi";
	status = "okay";
	dc-gpios = <&gpio0 16 GPIO_ACTIVE_HIGH>;	/* DET */
	/* reset-gpios = <&gpio0 25 GPIO_ACTIVE_LOW>; */	/* RESX reset */

        spi-dev = <&spi0>;
	write-only;
        #address-cells = <1>;
        #size-cells = <0>;

	/* Pico Display Pack2 */
	st7789v: st7789v@0 {
		compatible = "sitronix,st7789v";
		reg = <0>;
		/* DMA keeps SCK gapless, unlike polling which inserted FIFO-refill
		 * gaps that gave the panel timing margin. PL022 (pclk 125M, prescale 2)
		 * can only do 125/4=31.25M, 125/6=20.83M, 125/8=15.625M and picks the
		 * fastest <= this value. Continuous DMA on this HAT garbled at both
		 * 31.25M (old 48M setting) and 20.83M; 15.625M is the highest verified
		 * stable rate. Raise only if the panel wiring/connector improves. */
		mipi-max-frequency = <DT_FREQ_M(16)>;
		width = <320>;
		height = <240>;
		x-offset = <0>;
		y-offset = <0>;
		vcom = <0x1f>;   /* VCOMS Setting: 0.875V */
		gctrl = <0x35>;  /* VGH: 13.26V VGL: -10.43V */
		vrhs = <0x12>;
		vdvs = <0x20>;
		mdac = <0x70>;  /* Rotate 270 */
		gamma = <0x03>;
		colmod = <0x05>; /* 16 bit/pixel */
		lcm = <0x2c>;
		porch-param = [0c 0c 00 33 33];
		cmd2en-param = [5a 69 02 01];
		pwctrl1-param = [a4 a1];
		pvgam-param = [D0 08 11 08 0C 15 39 33 50 36 13 14 29 2D];
		nvgam-param = [D0 08 10 08 06 06 39 44 51 0B 16 14 2F 31];
		ram-param = [00 F0];
		rgb-param = [CD 08 14];
                mipi-mode = "MIPI_DBI_MODE_SPI_4WIRE";
	};
     };
};
