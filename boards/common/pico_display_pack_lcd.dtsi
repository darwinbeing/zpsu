/ {
    mipi_dbi {
        compatible = "zephyr,mipi-dbi-spi";
        status = "okay";

        dc-gpios = <&gpio0 16 GPIO_ACTIVE_HIGH>;
        spi-dev = <&spi0>;
        write-only;

        #address-cells = <1>;
        #size-cells = <0>;

        st7789v: st7789v@0 {
            compatible = "sitronix,st7789v";
            reg = <0>;
            /* Conservative rate mirroring the pack2 result: continuous DMA
             * needs a lower SCK than gapped polling. 16M -> 15.625M was the
             * highest stable rate verified on pack2; unvalidated on this 1.0
             * panel, so start safe and tune up if it proves solid here. */
            mipi-max-frequency = <DT_FREQ_M(16)>;

            width = <240>;
            height = <135>;
            x-offset = <40>;
            y-offset = <53>;

            vcom = <0x3D>;
            gctrl = <0x75>;
            vrhs = <0x00>;
            vdvs = <0x20>;
            mdac = <0x70>;
            gamma = <0x03>;
            colmod = <0x05>;
            lcm = <0x2c>;

            porch-param = [0c 0c 00 33 33];
            cmd2en-param = [5a 69 02 01];
            pwctrl1-param = [a4 a1];
            pvgam-param = [70 04 08 09 09 05 2A 33 41 07 13 13 29 2f];
            nvgam-param = [70 03 09 0A 09 06 2B 34 41 07 12 14 28 2E];
            ram-param = [00 F0];
            rgb-param = [CD 08 14];

            mipi-mode = "MIPI_DBI_MODE_SPI_4WIRE";
        };
    };
};
